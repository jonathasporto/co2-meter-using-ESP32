## sdkconfig.defaults
```kconfig
CONFIG_FATFS_LFN_NONE=n
CONFIG_FATFS_CODEPAGE_437=y
CONFIG_FATFS_LFN_HEAP=y     # ou CONFIG_FATFS_LFN_STACK=y
CONFIG_FATFS_LONG_FILENAMES=y

CONFIG_HTTPD_MAX_REQ_HDR_LEN=1024
CONFIG_HTTPD_MAX_URI_LEN=1024
CONFIG_HTTPD_STACK_SIZE=16384
```
